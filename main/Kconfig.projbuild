## main/Kconfig.projbuild
```kconfig
menu "Pin Config"
config GPIO_0
  int "GPIO pin #0"
  default 15
  help
    Set the GPIO pin for Pin #0

config GPIO_1
  int "GPIO pin #1"
  default 16
  help
    Set the GPIO pin for Pin #1

config GPIO_2
  int "GPIO pin #2"
  default 17
  help
    Set the GPIO pin for Pin #2

config S_CLK
  int "Screen GPIO CLK Pin"
  default 22
  help
    Set Screen Clock Pin

config S_DAT
  int "Screen GPIO DATA Pin"
  default 21
  help
    Set Screen Data Pin

config S_DAT
endmenu

menu "Connection Configuration"
	config ESP_WIFI_SSID
			string "WiFi SSID"
			default ""
			help
					SSID (network name)

	config ESP_WIFI_PASSWORD
			string "WiFi Password"
			default ""
			help
					WiFi password (WPA or WPA2)
endmenu
```
